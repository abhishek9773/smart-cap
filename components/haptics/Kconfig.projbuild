## components/haptics/Kconfig.projbuild
```kconfig
menu "Smart Cap Haptics"

config SMARTCAP_HAPTIC_TEST_ENABLE
    bool "Enable repeating vibration-module hardware test"
    default n
    help
        Starts the GPIO15/GPIO16 motor test after application initialization.
        Leave disabled for normal firmware operation.

config SMARTCAP_HAPTIC_ACTIVE_HIGH
    bool "Motor module IN is active high"
    default y
    help
        Disable this option if the motor module activates when IN is low.
        Confirm the module's actual documentation before changing this setting.

endmenu
```

## components/wifi_manager/Kconfig.projbuild
```kconfig
menu "Smart Cap Wi-Fi AP"

config SMARTCAP_WIFI_SSID
    string "Access point SSID"
    default "SMARTCAP_TEST"

config SMARTCAP_WIFI_PASSWORD
    string "Access point password"
    default "smartcap123"
    help
        Use at least 8 characters for WPA2. This default is for development
        only; set a unique password for each deployed prototype.

config SMARTCAP_WIFI_IP
    string "Access point IPv4 address"
    default "192.168.4.1"

endmenu
```
